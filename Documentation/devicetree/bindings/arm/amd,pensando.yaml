## Documentation/devicetree/bindings/arm/amd,pensando.yaml
```yaml
# SPDX-License-Identifier: (GPL-2.0-only OR BSD-2-Clause)
%YAML 1.2
---
$id: http://devicetree.org/schemas/arm/amd,pensando.yaml#
$schema: http://devicetree.org/meta-schemas/core.yaml#

title: AMD Pensando SoC Platforms

maintainers:
  - Brad Larson <bradley.larson@amd.com>

description:
  Device trees for AMD Pensando Elba, Giglio, and Salina platform variants.

properties:
  $nodename:
    const: "/"

  compatible:
    oneOf:
      - description: Boards with AMD Pensando Elba SoC
        items:
          - enum:
              - amd,pensando-elba-ortano
          - const: amd,pensando-elba

      - description: Boards with AMD Pensando Giglio SoC
        items:
          - const: amd,pensando-giglio

      - description: Boards with Pensando Giglio SoC
        items:
          - const: pensando,giglio

      - description: Boards with Pensando Salina SoC
        items:
          - const: pensando,salina

      - description: Boards with Pensando Salina A35 SoC
        items:
          - const: pensando,salina-a35

additionalProperties: true

...
```

## Documentation/devicetree/bindings/edac/pensando,elba-edac.yaml
```yaml
# SPDX-License-Identifier: (GPL-2.0 OR BSD-2-Clause)
%YAML 1.2
---
$id: http://devicetree.org/schemas/edac/pensando,elba-edac.yaml#
$schema: http://devicetree.org/meta-schemas/core.yaml#

title: AMD Pensando Elba and Giglio memory controller EDAC

maintainers:
  - Brad Larson <blarson@amd.com>

properties:
  compatible:
    enum:
      - pensando,elba-edac-mc
      - pensando,giglio-edac-mc
      - pensando,salina-edac-mc

  reg:
    minItems: 1
    maxItems: 8

  interrupts:
    minItems: 1
    maxItems: 8

required:
  - compatible

additionalProperties: true

examples:
  - |
    memory-controller {
        compatible = "pensando,elba-edac-mc";
    };

...
```

## Documentation/devicetree/bindings/interrupt-controller/pensando,soc-ictlr-csrintr.yaml
```yaml
# SPDX-License-Identifier: (GPL-2.0 OR BSD-2-Clause)
%YAML 1.2
---
$id: http://devicetree.org/schemas/interrupt-controller/pensando,soc-ictlr-csrintr.yaml#
$schema: http://devicetree.org/meta-schemas/core.yaml#

title: AMD Pensando SoC CSR interrupt controller

maintainers:
  - Brad Larson <blarson@amd.com>

properties:
  compatible:
    const: pensando,soc-ictlr-csrintr

  reg:
    maxItems: 1

  interrupts:
    minItems: 1
    maxItems: 32

  interrupt-controller: true

  '#interrupt-cells':
    const: 2

required:
  - compatible
  - interrupt-controller
  - '#interrupt-cells'

additionalProperties: true

examples:
  - |
    interrupt-controller {
        compatible = "pensando,soc-ictlr-csrintr";
        interrupt-controller;
        #interrupt-cells = <2>;
    };

...
```

## Documentation/devicetree/bindings/mfd/amd,pensando-elbasr.yaml
```yaml
# SPDX-License-Identifier: (GPL-2.0 OR BSD-2-Clause)
%YAML 1.2
---
$id: http://devicetree.org/schemas/mfd/amd,pensando-elbasr.yaml#
$schema: http://devicetree.org/meta-schemas/core.yaml#

title: AMD Pensando Elba SoC Resource Controller

description: |
  AMD Pensando Elba SoC Resource Controller attached to a SPI bus.
  The device may expose reset controller and other child devices.

maintainers:
  - Brad Larson <bradley.larson@amd.com>

properties:
  compatible:
    items:
      - const: amd,pensando-elbasr
      - const: simple-mfd

  reg:
    maxItems: 1

  spi-max-frequency:
    description: Maximum SPI frequency of the device in Hz.

  '#address-cells':
    const: 1

  '#size-cells':
    const: 0

  interrupts:
    maxItems: 1

  rtc:
    type: object
    additionalProperties: false
    description:
      Optional RTC routed through the CPLD, present only on cards that wire an
      FPGA RTC to the resource controller. Register access is provided by the
      parent elbasr SPI regmap, so the node carries no reg of its own.
    properties:
      compatible:
        const: amd,pensando-elbasr-rtc
    required:
      - compatible

required:
  - compatible
  - reg
  - spi-max-frequency

patternProperties:
  '^reset-controller@[0-9a-f]+$':
    $ref: /schemas/reset/amd,pensando-elbasr-reset.yaml#

additionalProperties: false

examples:
  - |
    #include <dt-bindings/reset/amd,pensando-elba-reset.h>
    #include <dt-bindings/interrupt-controller/arm-gic.h>

    spi {
        #address-cells = <1>;
        #size-cells = <0>;

        spi@0 {
            compatible = "amd,pensando-elbasr", "simple-mfd";
            reg = <0>;
            spi-max-frequency = <12000000>;
            #address-cells = <1>;
            #size-cells = <0>;

            rstc: reset-controller@0 {
                compatible = "amd,pensando-elbasr-reset";
                reg = <0>;
                #reset-cells = <1>;
            };
        };

        spi@1 {
            compatible = "amd,pensando-elbasr", "simple-mfd";
            reg = <1>;
            spi-max-frequency = <12000000>;
        };

        spi@2 {
            compatible = "amd,pensando-elbasr", "simple-mfd";
            reg = <2>;
            spi-max-frequency = <12000000>;
            interrupt-parent = <&porta>;
            interrupts = <0 IRQ_TYPE_LEVEL_LOW>;
        };

        spi@3 {
            compatible = "amd,pensando-elbasr", "simple-mfd";
            reg = <3>;
            spi-max-frequency = <12000000>;
        };
    };
```

## Documentation/devicetree/bindings/net/pensando,mnet.yaml
```yaml
# SPDX-License-Identifier: (GPL-2.0 OR BSD-2-Clause)
%YAML 1.2
---
$id: http://devicetree.org/schemas/net/pensando,mnet.yaml#
$schema: http://devicetree.org/meta-schemas/core.yaml#

title: AMD Pensando MNET (Management Network) Device

description:
  AMD Pensando internal management network device.

maintainers:
  - Brad Larson <bradley.larson@amd.com>

properties:
  compatible:
    const: pensando,mnet

  msi-parent:
    description:
      MSI parent for the MNET device.

  memory-region:
    maxItems: 1
    description:
      Reserved memory region shared by MNET devices.

required:
  - compatible
  - msi-parent
  - memory-region

additionalProperties: false

examples:
  - |
    / {
        model = "AMD Pensando MNET example";
        compatible = "amd,pensando-elba-ortano", "amd,pensando-elba";
        #address-cells = <2>;
        #size-cells = <2>;

        soc {
            compatible = "simple-bus";
            #address-cells = <2>;
            #size-cells = <2>;
            ranges;

            gic_its: interrupt-controller@1040000 {
                compatible = "arm,gic-v3-its";
                msi-controller;
                #msi-cells = <1>;
                reg = <0x0 0x1040000 0x0 0x20000>;
            };
        };

        reserved-memory {
            #address-cells = <2>;
            #size-cells = <2>;
            ranges;

            mnet_reserved: mnet-dma-region@80000000 {
                compatible = "shared-dma-pool";
                reg = <0x0 0x80000000 0x0 0x100000>;
                no-map;
            };
        };

        mnet@0 {
            compatible = "pensando,mnet";
            msi-parent = <&gic_its 0x0>;
            memory-region = <&mnet_reserved>;
        };
    };
```

## Documentation/devicetree/bindings/soc/amd/amd,tawk-ipc.yaml
```yaml
# SPDX-License-Identifier: (GPL-2.0 OR BSD-2-Clause)
%YAML 1.2
---
$id: http://devicetree.org/schemas/soc/amd/amd,tawk-ipc.yaml#
$schema: http://devicetree.org/meta-schemas/core.yaml#

title: AMD Pensando TAWK IPC memory region

maintainers:
  - Brad Larson <blarson@amd.com>

description:
  Shared memory and mailbox register description for the AMD Pensando TAWK
  IPC interface.

properties:
  compatible:
    const: amd,tawk-ipc

  reg:
    minItems: 1
    maxItems: 8

  rst-sigs:
    $ref: /schemas/types.yaml#/definitions/uint32-array

  nmboxes:
    $ref: /schemas/types.yaml#/definitions/uint32

  mbox-ctl:
    $ref: /schemas/types.yaml#/definitions/uint32-array

required:
  - compatible
  - reg

additionalProperties: false

examples:
  - |
    ipc@0 {
        compatible = "amd,tawk-ipc";
        reg = <0x0 0x0>;
        rst-sigs = <0x4 0x0>;
        nmboxes = <2>;
        mbox-ctl = <0x0 0x3>;
    };

...
```

## Documentation/devicetree/bindings/soc/pensando/pensando,bsm.yaml
```yaml
# SPDX-License-Identifier: (GPL-2.0 OR BSD-2-Clause)
%YAML 1.2
---
$id: http://devicetree.org/schemas/soc/pensando/pensando,bsm.yaml#
$schema: http://devicetree.org/meta-schemas/core.yaml#

title: AMD Pensando boot state machine device

maintainers:
  - Brad Larson <blarson@amd.com>

properties:
  compatible:
    const: pensando,bsm

  reg:
    maxItems: 1

required:
  - compatible

additionalProperties: true

examples:
  - |
    bsm {
        compatible = "pensando,bsm";
    };

...
```

## Documentation/devicetree/bindings/soc/pensando/pensando,capmem.yaml
```yaml
# SPDX-License-Identifier: (GPL-2.0 OR BSD-2-Clause)
%YAML 1.2
---
$id: http://devicetree.org/schemas/soc/pensando/pensando,capmem.yaml#
$schema: http://devicetree.org/meta-schemas/core.yaml#

title: AMD Pensando capability memory window

maintainers:
  - Brad Larson <blarson@amd.com>

description:
  Memory ranges made accessible to Pensando PCIe endpoints with per-range
  attributes.

properties:
  compatible:
    const: pensando,capmem

  pensando,capmem-fixed-ranges:
    $ref: /schemas/types.yaml#/definitions/uint32-matrix
    description: Fixed capability memory ranges and attributes.

  pensando,capmem-ranges:
    $ref: /schemas/types.yaml#/definitions/uint32-matrix
    deprecated: true

required:
  - compatible

additionalProperties: false

examples:
  - |
    capmem {
        compatible = "pensando,capmem";
        pensando,capmem-fixed-ranges = <0x0 0x10000 0x0 0x70000000 0x0>;
    };

...
```

## Documentation/devicetree/bindings/soc/pensando/pensando,capri-crash.yaml
```yaml
# SPDX-License-Identifier: (GPL-2.0 OR BSD-2-Clause)
%YAML 1.2
---
$id: http://devicetree.org/schemas/soc/pensando/pensando,capri-crash.yaml#
$schema: http://devicetree.org/meta-schemas/core.yaml#

title: AMD Pensando persistent panic crash log memory

maintainers:
  - Brad Larson <blarson@amd.com>

properties:
  compatible:
    const: pensando,capri-crash

  reg:
    maxItems: 1

  status: true

required:
  - compatible
  - reg

additionalProperties: false

examples:
  - |
    panicdump@0 {
        compatible = "pensando,capri-crash";
        reg = <0x0 0x100000>;
    };

...
```

## Documentation/devicetree/bindings/soc/pensando/pensando,kpcimgr.yaml
```yaml
# SPDX-License-Identifier: (GPL-2.0 OR BSD-2-Clause)
%YAML 1.2
---
$id: http://devicetree.org/schemas/soc/pensando/pensando,kpcimgr.yaml#
$schema: http://devicetree.org/meta-schemas/core.yaml#

title: AMD Pensando kernel PCI manager

maintainers:
  - Brad Larson <blarson@amd.com>

properties:
  compatible:
    const: pensando,kpcimgr

  reg:
    minItems: 1
    maxItems: 8

  interrupts:
    minItems: 1
    maxItems: 32

required:
  - compatible

additionalProperties: true

examples:
  - |
    kpcimgr {
        compatible = "pensando,kpcimgr";
    };

...
```

## Documentation/devicetree/bindings/soc/pensando/pensando,mcrypt.yaml
```yaml
# SPDX-License-Identifier: (GPL-2.0 OR BSD-2-Clause)
%YAML 1.2
---
$id: http://devicetree.org/schemas/soc/pensando/pensando,mcrypt.yaml#
$schema: http://devicetree.org/meta-schemas/core.yaml#

title: AMD Pensando MCRYPT platform device

maintainers:
  - Brad Larson <bradley.larson@amd.com>

description:
  AMD Pensando MCRYPT platform device using platform MSI interrupts.

properties:
  compatible:
    const: pensando,mcrypt

  msi-parent:
    description:
      MSI parent for the MCRYPT device.

required:
  - compatible
  - msi-parent

additionalProperties: false

examples:
  - |
    / {
        #address-cells = <2>;
        #size-cells = <2>;

        soc {
            compatible = "simple-bus";
            #address-cells = <2>;
            #size-cells = <2>;
            ranges;

            gic_its: interrupt-controller@1040000 {
                compatible = "arm,gic-v3-its";
                msi-controller;
                #msi-cells = <1>;
                reg = <0x0 0x1040000 0x0 0x20000>;
            };
        };

        mcrypt0 {
            compatible = "pensando,mcrypt";
            msi-parent = <&gic_its 0xb>;
        };
    };
```

## Documentation/devicetree/bindings/soc/pensando/pensando,mssoc.yaml
```yaml
# SPDX-License-Identifier: (GPL-2.0 OR BSD-2-Clause)
%YAML 1.2
---
$id: http://devicetree.org/schemas/soc/pensando/pensando,mssoc.yaml#
$schema: http://devicetree.org/meta-schemas/core.yaml#

title: AMD Pensando miscellaneous SoC syscon block

maintainers:
  - Brad Larson <blarson@amd.com>

properties:
  compatible:
    items:
      - const: pensando,mssoc
      - const: syscon

  reg:
    maxItems: 1

required:
  - compatible
  - reg

additionalProperties: false

examples:
  - |
    syscon@61000000 {
        compatible = "pensando,mssoc", "syscon";
        reg = <0x61000000 0x80000>;
    };

...
```

## Documentation/devicetree/bindings/soc/pensando/pensando,pcie.yaml
```yaml
# SPDX-License-Identifier: (GPL-2.0 OR BSD-2-Clause)
%YAML 1.2
---
$id: http://devicetree.org/schemas/soc/pensando/pensando,pcie.yaml#
$schema: http://devicetree.org/meta-schemas/core.yaml#

title: AMD Pensando PCIe platform control block

maintainers:
  - Brad Larson <blarson@amd.com>

properties:
  compatible:
    const: pensando,pcie

  reg:
    minItems: 1
    maxItems: 8

required:
  - compatible

additionalProperties: true

examples:
  - |
    pcie {
        compatible = "pensando,pcie";
        reg = <0x0 0x1000>;
    };

...
```

## Documentation/devicetree/bindings/soc/pensando/pensando,penfw.yaml
```yaml
# SPDX-License-Identifier: (GPL-2.0 OR BSD-2-Clause)
%YAML 1.2
---
$id: http://devicetree.org/schemas/soc/pensando/pensando,penfw.yaml#
$schema: http://devicetree.org/meta-schemas/core.yaml#

title: AMD Pensando firmware interface

maintainers:
  - Brad Larson <blarson@amd.com>

properties:
  compatible:
    const: pensando,penfw

  method:
    description: Firmware call method.
    enum:
      - smc
      - hvc

required:
  - compatible

additionalProperties: true

examples:
  - |
    firmware {
        penfw {
            compatible = "pensando,penfw";
            method = "smc";
        };
    };

...
```

## Documentation/devicetree/bindings/soc/pensando/pensando,platform-interrupt.yaml
```yaml
# SPDX-License-Identifier: (GPL-2.0 OR BSD-2-Clause)
%YAML 1.2
---
$id: http://devicetree.org/schemas/soc/pensando/pensando,platform-interrupt.yaml#
$schema: http://devicetree.org/meta-schemas/core.yaml#

title: AMD Pensando platform interrupt helper devices

maintainers:
  - Brad Larson <blarson@amd.com>

description:
  Small platform devices used to route or handle Pensando SoC-specific
  interrupts.

properties:
  compatible:
    enum:
      - pensando,salina-cmn-pmu-interrupt
      - pensando,giglio-emmc-interrupt

  interrupts:
    maxItems: 1

  reg:
    minItems: 1
    maxItems: 2

required:
  - compatible

additionalProperties: true

examples:
  - |
    interrupt-helper {
        compatible = "pensando,salina-cmn-pmu-interrupt";
        interrupts = <53>;
    };

...
```

## Documentation/devicetree/bindings/soc/pensando/pensando,rstcause.yaml
```yaml
# SPDX-License-Identifier: (GPL-2.0 OR BSD-2-Clause)
%YAML 1.2
---
$id: http://devicetree.org/schemas/soc/pensando/pensando,rstcause.yaml#
$schema: http://devicetree.org/meta-schemas/core.yaml#

title: AMD Pensando reset cause registers

maintainers:
  - Brad Larson <blarson@amd.com>

properties:
  compatible:
    const: pensando,rstcause

  pensando,causeregs:
    $ref: /schemas/types.yaml#/definitions/phandle-array
    description: Syscon phandle and offset for reset cause registers.

required:
  - compatible
  - pensando,causeregs

additionalProperties: false

examples:
  - |
    rstcause {
        compatible = "pensando,rstcause";
        pensando,causeregs = <&mssoc 0x204>;
    };

...
```
