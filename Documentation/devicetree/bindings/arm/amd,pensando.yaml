## Documentation/devicetree/bindings/soc/pensando/pensando,sbus.yaml
```yaml
# SPDX-License-Identifier: (GPL-2.0 OR BSD-2-Clause)
%YAML 1.2
---
$id: http://devicetree.org/schemas/soc/pensando/pensando,sbus.yaml#
$schema: http://devicetree.org/meta-schemas/core.yaml#

title: AMD Pensando serial bus controller

maintainers:
  - Brad Larson <blarson@amd.com>

properties:
  compatible:
    const: pensando,sbus

  reg:
    minItems: 1
    maxItems: 4

required:
  - compatible

additionalProperties: true

examples:
  - |
    sbus@0 {
        compatible = "pensando,sbus";
        reg = <0x0 0x1000>;
    };

...
```

## Documentation/devicetree/bindings/soc/pensando/pensando,uio.yaml
```yaml
# SPDX-License-Identifier: (GPL-2.0 OR BSD-2-Clause)
%YAML 1.2
---
$id: http://devicetree.org/schemas/soc/pensando/pensando,uio.yaml#
$schema: http://devicetree.org/meta-schemas/core.yaml#

title: AMD Pensando UIO platform devices

maintainers:
  - Brad Larson <blarson@amd.com>

description:
  UIO devices used by AMD Pensando platform software for MSI, PCIe MAC,
  and link MAC access.

properties:
  compatible:
    enum:
      - pensando,uio_penmsi
      - pensando,uio_penmsi1
      - pensando,uio_pciemac
      - pensando,uio_linkmac

  reg:
    minItems: 1
    maxItems: 16

  interrupts:
    minItems: 1
    maxItems: 32

  num-interrupts:
    $ref: /schemas/types.yaml#/definitions/uint32
    description:
      Number of platform MSI interrupts to allocate.

  name:
    $ref: /schemas/types.yaml#/definitions/string
    description:
      Optional userspace-visible UIO device name.

required:
  - compatible

allOf:
  - if:
      properties:
        compatible:
          contains:
            enum:
              - pensando,uio_penmsi
              - pensando,uio_penmsi1
    then:
      required:
        - num-interrupts

additionalProperties: true

examples:
  - |
    uio_penmsi {
        compatible = "pensando,uio_penmsi";
        num-interrupts = <1>;
    };

  - |
    uio_penmsi1 {
        compatible = "pensando,uio_penmsi1";
        num-interrupts = <1>;
    };

  - |
    uio_pciemac {
        compatible = "pensando,uio_pciemac";
    };

  - |
    uio_linkmac {
        compatible = "pensando,uio_linkmac";
    };
```

## Documentation/devicetree/bindings/spi/amd,pensando-cpld-rd1173.yaml
```yaml
# SPDX-License-Identifier: (GPL-2.0 OR BSD-2-Clause)
%YAML 1.2
---
$id: http://devicetree.org/schemas/spi/amd,pensando-cpld-rd1173.yaml#
$schema: http://devicetree.org/meta-schemas/core.yaml#

title: AMD Pensando CPLD RD1173 SPI-to-I2C Bridge

description: |
  SPI-connected Lattice RD1173 I2C controller present on the Pensando
  Elba/Salina CPLD. It provides two I2C masters and is typically used
  for transceiver EEPROM / module access.

maintainers:
  - Brad Larson <bradley.larson@amd.com>

properties:
  compatible:
    const: amd,pensando-cpld-rd1173

  reg:
    maxItems: 1

  spi-max-frequency:
    maximum: 10000000

  interrupts:
    maxItems: 1

  interrupt-gpios:
    maxItems: 1

required:
  - compatible
  - reg
  - spi-max-frequency

additionalProperties: false

examples:
  - |
    #include <dt-bindings/gpio/gpio.h>
    #include <dt-bindings/interrupt-controller/irq.h>

    spi {
        #address-cells = <1>;
        #size-cells = <0>;

        cpld@2 {
            compatible = "amd,pensando-cpld-rd1173";
            reg = <2>;
            spi-max-frequency = <5000000>;
            interrupt-parent = <&gpio>;
            interrupts = <22 IRQ_TYPE_LEVEL_LOW>;
        };
    };
```

## Documentation/devicetree/bindings/spi/amd,pensando-cpld-spimux.yaml
```yaml
# SPDX-License-Identifier: (GPL-2.0 OR BSD-2-Clause)
%YAML 1.2
---
$id: http://devicetree.org/schemas/spi/amd,pensando-cpld-spimux.yaml#
$schema: http://devicetree.org/meta-schemas/core.yaml#

title: AMD Pensando CPLD SPI mux

maintainers:
  - Brad Larson <blarson@amd.com>

description:
  The AMD Pensando Salina CPLD contains a register selected SPI mux.  CS0
  accesses CPLD registers and virtual chip selects route transactions to
  CPLD internal flash, the RD1173 I2C bridge, and SMBus-over-SPI logic.

properties:
  compatible:
    const: amd,pensando-cpld-spimux

  reg:
    maxItems: 1

  spi-max-frequency: true

  '#address-cells':
    const: 1

  '#size-cells':
    const: 0

required:
  - compatible
  - reg
  - '#address-cells'
  - '#size-cells'

additionalProperties:
  type: object

examples:
  - |
    spi {
        #address-cells = <1>;
        #size-cells = <0>;

        spi@0 {
            compatible = "amd,pensando-cpld-spimux";
            reg = <0>;
            spi-max-frequency = <12000000>;
            #address-cells = <1>;
            #size-cells = <0>;

            i2c-bridge@2 {
                compatible = "amd,pensando-cpld-rd1173";
                reg = <2>;
                spi-max-frequency = <12000000>;
            };
        };
    };

...
```
