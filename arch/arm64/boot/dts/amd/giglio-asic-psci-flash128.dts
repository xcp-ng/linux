// SPDX-License-Identifier: (GPL-2.0-only or BSD-2-Clause)
/*
 * Copyright 2020-2022 Advanced Micro Devices, Inc.
 */

/dts-v1/;

#include "giglio.dtsi"
#include "elba-16core.dtsi"
#include "elba-16core-psci.dtsi"
#include "giglio-asic-common.dtsi"
#include "elba-flash128-parts.dtsi"
#include "elba-asic-memory.dtsi"
#include "elba-mdev.dtsi"

/ {
	model = "AMD Pensando Giglio Board";
	compatible = "amd,pensando-giglio";

	aliases {
		serial0 = &uart0;
		spi0 = &spi0;
		spi1 = &qspi;
	};

	chosen {
		stdout-path = "serial0:115200n8";
	};
};
